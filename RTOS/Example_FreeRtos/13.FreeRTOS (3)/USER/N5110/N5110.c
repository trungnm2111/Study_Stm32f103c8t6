#include "N5110.h"


const unsigned char  font6x8[92][6] =
{
 0x00, 0x00, 0x00, 0x00, 0x00,// sp
 0x00, 0x00, 0x00, 0x2f, 0x00, 0x00,// !
 0x00, 0x00, 0x07, 0x00, 0x07, 0x00,// "
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 0x14, 0x14, 0x14, 0x14, 0x14, 0x14,0x00// horiz lines
};



static void Fn_N5110_CDMode (uint8_t Mode){
	if(Mode){
		N5110_PIN_CD_Port->BSRR = N5110_PIN_CD_Pin;
	}
	else{
		N5110_PIN_CD_Port->BRR = N5110_PIN_CD_Pin;
	}
}

void Fn_N5110_WriteData(uint8_t Data){
	GPIO_ResetBits(N5110_PIN_CS_Port, N5110_PIN_CS_Pin);
	Fn_DELAY_Long(2);
	Fn_N5110_CDMode(1);
	Fn_SPIx_Transfer(Data);
	GPIO_SetBits(N5110_PIN_CS_Port, N5110_PIN_CS_Pin);
}

void Fn_N5110_WriteCommand(uint8_t Command){
	GPIO_ResetBits(N5110_PIN_CS_Port, N5110_PIN_CS_Pin);
	Fn_DELAY_Long(2);
	Fn_N5110_CDMode(0);
	Fn_SPIx_Transfer(Command);
	GPIO_SetBits(N5110_PIN_CS_Port, N5110_PIN_CS_Pin);
}

void Fn_N5110_Init(void){
	GPIO_InitTypeDef GPIO_InitStruct;
	
	RCC_APB2PeriphClockCmd(RCC_APB2Periph_AFIO | RCC_APB2Periph_GPIOA, ENABLE);
	GPIO_InitStruct.GPIO_Pin = GPIO_Pin_0 | GPIO_Pin_1 | GPIO_Pin_2 | GPIO_Pin_3;
    GPIO_InitStruct.GPIO_Mode = GPIO_Mode_Out_PP;
    GPIO_InitStruct.GPIO_Speed = GPIO_Speed_10MHz;
    GPIO_Init(GPIOA, &GPIO_InitStruct);
	
	Fn_SPI_Init();
	Fn_DELAY_Long(10);
	Fn_SPIx_Transfer(0x00);
	
	GPIO_SetBits(N5110_PIN_CS_Port, N5110_PIN_CS_Pin);
	Fn_DELAY_Long(100);
	GPIO_ResetBits(N5110_PIN_RS_Port, N5110_PIN_RS_Pin);
	Fn_DELAY_Long(100);
	GPIO_SetBits(N5110_PIN_RS_Port, N5110_PIN_RS_Pin);
	Fn_DELAY_Long(100);
	
	Fn_N5110_WriteCommand(NIKIA5110_FUNCTION_HORIZONTA_EX); //0x21 Lenh them, va dung che do ngang 
	Fn_N5110_WriteCommand(0xc0);
	Fn_N5110_WriteCommand(NIKIA5110_FUNCTION_HORIZONTA_BA);//0x20Lenh co ban, va dung che do ngang
	Fn_N5110_WriteCommand(NIKIA5110_DISPLAY_NORMAL);
	
	
	
	// Cai do tuong phan
	Fn_N5110_WriteCommand(0x21);
	Fn_N5110_WriteCommand(0x80|0x40);
	Fn_N5110_WriteCommand(0x20);
	Fn_N5110_Clear();
	Fn_N5110_GotoXY(0,0);
	Fn_N5110_Puts("Hello");
}
void Fn_N5110_GotoXY(uint8_t X, uint8_t Y){
	Fn_N5110_WriteCommand(0x40 | Y);    // column
	Fn_N5110_WriteCommand(0x80 | X);    // row
}

void Fn_N5110_Clear(void){
	uint8_t t;
	uint8_t k;
	Fn_N5110_GotoXY(0,0); 
	for(t=0;t<NOKIA5110_Y_ARRAY_SIZE;t++)
	{
		for(k=0;k<NOKIA5110_X_SIZE;k++)
		{
			Fn_N5110_WriteData(0xFF);
		}
	}
}
void Fn_N5110_PutChar(uint8_t C){
	uint8_t b;
	uint8_t line;
	b=C-32;   
	for (line=0; line<6; line++)
		Fn_N5110_WriteData(~font6x8[b][line]);
}
void Fn_N5110_Puts(uint8_t *s){
	while (*s)
	{
		Fn_N5110_PutChar(*s);
		s++;
	}
}

